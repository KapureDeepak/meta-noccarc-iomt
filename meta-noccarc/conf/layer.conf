## meta-noccarc/conf/layer.conf
```bitbake
# We have a conf and classes directory, add to BBPATH
BBPATH .= ":${LAYERDIR}"

# We have a packages directory, add to BBFILES
BBFILES += "${LAYERDIR}/recipes-*/*/*.bb \
            ${LAYERDIR}/recipes-*/*/*.bbappend"

# Miscellaneous configurations for V730i
hostname_pn-base-files = "V730i-system-iomt"
INHERIT += "extrausers"
EXTRA_USERS_PARAMS = "usermod -P noccarc root;"
```
